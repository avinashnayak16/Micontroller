/*//Generate a waveform with varying time delays on pb5 using timer2
.INCLUDE "M32DEF.INC"
.MACRO INITSTACK ; SETUP THE STACK
	LDI R20,HIGH(RAMEND)
	OUT SPH,R20
	LDI R20,LOW(RAMEND)
	OUT SPL,R20
.ENDMACRO
	INITSTACK
	SBI DDRB,5
BEGIN:SBI PORTB,5
	  RCALL DELAY
	  RCALL DELAY
	  RCALL DELAY

	  CBI PORTB,5
	  RCALL DELAY

	  SBI PORTB,5
	  RCALL DELAY

	  CBI PORTB,5
	  RCALL DELAY

	  SBI PORTB,5
	  RCALL DELAY

	  CBI PORTB,5
	  RCALL DELAY
	  RCALL DELAY

	  RJMP BEGIN

DELAY:LDI R20,0XF0
	  OUT TCNT2,R20
	  LDI R20,0X01
	  OUT TCCR2,R20
AGAIN:IN R20,TIFR
	  SBRS R20,TOV2
	  RJMP AGAIN
	  LDI R20,0X00
	  OUT TCCR2,R20
	  LDI R20,(1<<TOV2)
	  OUT TIFR,R20
	  RET


//Generate a waveform with varying time delays 1 sec on pb4 using timer2
.INCLUDE "M32DEF.INC"
.MACRO INITSTACK ; SETUP THE STACK
	LDI R20,HIGH(RAMEND)
	OUT SPH,R20
	LDI R20,LOW(RAMEND)
	OUT SPL,R20
.ENDMACRO
	INITSTACK
	SBI DDRB,4
REPEAT :LDI R30 , 0X32
        SBI PORTB ,4
BACK1:RCALL DELAY
	  DEC R30 
	  BRNE BACK1
	  LDI R30,0X32
	  CBI PORTB,4
BACK2:RCALL DELAY
	  DEC R30 
	  BRNE BACK2
	  RJMP REPEAT

DELAY:LDI R20,0X64
	  OUT TCNT0,R20
	  LDI R20,0X05
	  OUT TCCR0,R20
AGAIN:IN R20,TIFR
	  SBRS R20,TOV0
	  RJMP AGAIN
	  LDI R20,0X00
	  OUT TCCR0,R20
	  LDI R20,(1<<TOV0)
	  OUT TIFR,R20
	  RET
*/

.INCLUDE "M32DEF.INC"

.MACRO INITSTACK ;set up stack
    LDI R20, HIGH(RAMEND)
    OUT SPH, R20
    LDI R20, LOW(RAMEND)
    OUT SPL, R20
.ENDMACRO

INITSTACK

LDI R16, 1<<5 ; R16 = 0x20 (0010 0000 for PB5)
SBI DDRB, 5 ; Set PB5 as an output

LDI R17, 0
OUT PORTB, R17 ; Clear PORTB

BEGIN:
    RCALL DELAY ; Call timer delay

    EOR R17, R16 ; Toggle D5 of R17 by Ex-Oring with 1
    OUT PORTB, R17 ; Toggle PB5

    RJMP BEGIN ; Repeat

DELAY:
    LDI R20, 0xF2 ; R20 = 0xF2
    OUT TCNT0, R20 ; Load timer0

    LDI R20, 0x01
    OUT TCCR0, R20 ; Timer, Normal mode, int clk, no prescaler

AGAIN:
    IN R20, TIFR ; Read TIFR
    SBRS R20, TOV0 ; If TOV0 is set, skip next instruction
    RJMP AGAIN

    LDI R20, 0x00
    OUT TCCR0, R20 ; Stop Timer0

    LDI R20, (1<<TOV0)
    OUT TIFR, R20 ; Clear TOV0 flag by writing a 1 to TIFR

    RET